## layers/meta-resin-rockchip/conf/layer.conf
```bitbake
BBPATH .= ":${LAYERDIR}"

BBFILES += "${LAYERDIR}/recipes-*/*/*.bb \
            ${LAYERDIR}/recipes-*/*/*.bbappend"

BBFILE_COLLECTIONS += "resin-rockchip"
BBFILE_PATTERN_resin-rockchip := "^${LAYERDIR}/"
BBFILE_PRIORITY_resin-rockchip = "1337"
```
